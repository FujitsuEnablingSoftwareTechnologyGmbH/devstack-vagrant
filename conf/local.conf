## conf/local.conf
```bitbake
[[local|localrc]]

# generic configuration parameters
ADMIN_PASSWORD=secretsecret
DATABASE_PASSWORD=$ADMIN_PASSWORD
RABBIT_PASSWORD=$ADMIN_PASSWORD
SERVICE_PASSWORD=$ADMIN_PASSWORD
SERVICE_TOKEN=$ADMIN_PASSWORD

MULTI_HOST="True"
API_RATE_LIMIT="False"
RECLONE="True"


# database configuration parameters
DATABASE_TYPE=mysql


# networking configuration parameters
GUEST_INTERFACE_DEFAULT=eth1
HOST_IP_IFACE=eth1


# logging configuration parameters
LOGFILE=/opt/stack/logs/stack.sh.log
VERBOSE=True
LOG_COLOR=True
SCREEN_LOGDIR=/opt/stack/logs


# services
disable_service \
	n-net tempest ceilometer-acompute ceilometer-acentral ceilometer-anotification \
	ceilometer-collector ceilometer-api

enable_service \
	neutron horizon key heat cinder mysql template rabbit \
	n-api n-compute n-sch n-cauth n-crt n-obj n-cpu n-cond \
	q-svc q-agt q-dhcp q-l3 q-meta \
	h-api h-api-cfn h-api-cw h-eng \
	c-api c-vol c-sch \
	s-proxy s-object s-container s-account \
	g-api g-reg


# configure images provided on glance (manager)
IMAGE_URLS="http://download.cirros-cloud.net/0.3.3/cirros-0.3.3-x86_64-uec.tar.gz"
IMAGE_URLS+=","


[[post-config|$NOVA_CONF]]
[DEFAULT]
flat_interface = eth1
vlan_interface = eth1
```
